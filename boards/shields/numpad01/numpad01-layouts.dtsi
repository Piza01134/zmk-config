#include <dt-bindings/zmk/matrix_transform.h>

/ {
    default_transform: matrix_transform_0 {
        compatible = "zmk,matrix-transform";

        columns = <4>;
        rows = <6>;

        map = <
            0 1 2 3
            4 5 6 7
            8 9 10 11
            12 13 14 15
            16 17 18 19
            20 21 22 23
        >;
    };

    chosen {
        zmk,matrix-transform = &default_transform;
    };
};