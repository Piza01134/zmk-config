#include <dt-bindings/zmk/matrix_transform.h>

/ {
    kscan0: kscan {
        compatible = "zmk,kscan-gpio-matrix";

        diode-direction = "col2row";

        row-gpios = <
            &gpio0 6  GPIO_ACTIVE_HIGH
            &gpio0 8  GPIO_ACTIVE_HIGH
            &gpio0 17 GPIO_ACTIVE_HIGH
            &gpio0 20 GPIO_ACTIVE_HIGH
            &gpio0 22 GPIO_ACTIVE_HIGH
            &gpio0 24 GPIO_ACTIVE_HIGH
        >;

        col-gpios = <
            &gpio0 9  GPIO_ACTIVE_HIGH
            &gpio0 10 GPIO_ACTIVE_HIGH
            &gpio0 11 GPIO_ACTIVE_HIGH
            &gpio0 12 GPIO_ACTIVE_HIGH
        >;
    };

    default_transform: matrix_transform {
        compatible = "zmk,matrix-transform";

        rows = <6>;
        columns = <4>;

        map = <
            0  1  2  3
            4  5  6  7
            8  9  10 11
            12 13 14 15
            16 17 18 19
            20 21 22 23
        >;
    };
};